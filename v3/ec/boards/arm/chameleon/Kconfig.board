## v3/ec/boards/arm/chameleon/Kconfig.board
```kconfig
# Google Chameleon

# Copyright 2020 The ChromiumOS Authors
# SPDX-License-Identifier: BSD-3-Clause

config BOARD_GOOGLE_CHAMELEON
	bool "Google Chameleon"
	depends on SOC_STM32H743XX
```

## v3/ec/boards/arm/chameleon/chameleon_defconfig
```kconfig
# SPDX-License-Identifier: BSD-3-Clause
#
# Copyright 2020 The Chromium OS Authors. All rights reserved.
# Use of this source code is governed by a BSD-style license that can be
# found in the LICENSE file.

# Zephyr Kernel Configuration
CONFIG_SOC_SERIES_STM32H7X=y

# Platform Configuration
CONFIG_SOC_STM32H753XX=y
CONFIG_BOARD_GOOGLE_CHAMELEON=y

# Serial Drivers
CONFIG_SERIAL=y
CONFIG_UART_INTERRUPT_DRIVEN=y

# Enable console
CONFIG_CONSOLE=y
CONFIG_UART_CONSOLE=y

# Pinmux Driver
CONFIG_PINMUX=y

# GPIO Controller
CONFIG_GPIO=y

# clock configuration
CONFIG_CLOCK_CONTROL=y

# ADCs
CONFIG_ADC=y
CONFIG_ADC_STM32=y
CONFIG_ADC_SHELL=n

# I2C
CONFIG_I2C=y

# PCA95xx-compatible I2C I/O expanders
CONFIG_GPIO_PCA95XX=y
```

## v3/fpga/u-boot/v3_core_periph.its
```
/*
 * Copyright 2022 The Chromium OS Authors. All rights reserved.
 * Use of this source code is governed by a BSD-style license that can be
 * found in the LICENSE file.
 */
/dts-v1/;

/ {
	description = "FIT image with FPGA bistream";
	#address-cells = <1>;

	images {
		fpga-periph-1 {
			description = "FPGA peripheral bitstream";
			data = /incbin/("../NAME.periph.rbf");
			type = "fpga";
			arch = "arm";
			compression = "none";
		};
		fpga-core-1 {
			description = "FPGA core bitstream";
			data = /incbin/("../NAME.core.rbf");
			type = "fpga";
			arch = "arm";
			compression = "none";
		};
	};

	configurations {
		default = "config-1";
		config-1 {
			description = "Boot with FPGA config";
			fpga = "fpga-periph-1", "fpga-core-1";
		};
	};
};
```
